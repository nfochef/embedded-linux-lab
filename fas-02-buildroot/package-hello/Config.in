## fas-02-buildroot/package-hello/Config.in
```kconfig
config BR2_PACKAGE_HELLO
	bool "hello"
	help
	  A simple hello-world program for learning Buildroot package recipes.

	  https://github.com/nfochef/embedded-linux-lab
```
